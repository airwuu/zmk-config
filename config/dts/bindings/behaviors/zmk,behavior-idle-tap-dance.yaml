## config/dts/bindings/behaviors/zmk,behavior-idle-tap-dance.yaml
```yaml
description: Idle-gated two-key tap dance behavior

compatible: "zmk,behavior-idle-tap-dance"

include: two_param.yaml

properties:
  bindings:
    type: phandles
    required: true
  tapping-term-ms:
    type: int
    default: 180
  require-prior-idle-ms:
    type: int
    default: 350
  primary-param2:
    type: int
    default: 0
  secondary-param2:
    type: int
    default: 0
```

## config/west.yml
```yaml
manifest:
  remotes:
    - name: zmkfirmware
      url-base: https://github.com/zmkfirmware
    - name: mctechnology17
      url-base: https://github.com/mctechnology17
    - name: eyelash
      url-base: https://github.com/a741725193
  projects:
    - name: zmk
      remote: zmkfirmware
      revision: v0.3.0
      import: app/west.yml
    - name: zmk-nice-oled
      remote: mctechnology17
      revision: 46f824abb2bd41f1287c5c68abd14122af6042a3
    - name: zmk-board-eyelash
      remote: eyelash
      revision: 29d53043035e08113996ae44083f23d8057a444e
  self:
    path: config
```

## module/Kconfig
```kconfig
config ZMK_BEHAVIOR_AUTO_SYMBOL
    bool
    default y
    depends on DT_HAS_ZMK_BEHAVIOR_AUTO_SYMBOL_ENABLED

if ZMK_BEHAVIOR_AUTO_SYMBOL

config ZMK_BEHAVIOR_AUTO_SYMBOL_MAX_HELD
    int "Auto Symbol Max Held"
    default 10

endif
```

## module/dts/bindings/behaviors/zmk,behavior-auto-symbol.yaml
```yaml
description: Solo-hold symbol behavior

compatible: "zmk,behavior-auto-symbol"

include: two_param.yaml

properties:
  bindings:
    type: phandles
    required: true
  tapping-term-ms:
    type: int
    default: 180
  interrupt-layer:
    type: int
    default: 255
```
